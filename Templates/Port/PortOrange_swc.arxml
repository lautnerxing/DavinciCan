AUTOSAR XML (schema 4-2-1)
standard types defined: boolean, uint8, boolean_CompuMethod, boolean_DataConstr, uint8_DataConstr
package /ComponentTypes
  application sw component type PortOrange
    provide port PpVMS_Apples_123ms: nonqueued-sender-com-spec{data-element=DeApples, init-value=constant-reference=C_RECORD_Apples}, provided-interface=PiVMS_Apples_123ms
    behavior PortOrange_InternalBehavior
  swc implementation PortOrange_Implementation: behavior=PortOrange_InternalBehavior
    code-descriptors:
      code Default: artifact-descriptors=autosar-engineering-object={short-label=Default, category=SWSRC}
package /Constants
  constant specification C_RECORD_Apples: value-spec=fields=[sig1:0, sig2:0, sig3:8 x 0]
package /DataTypes
  impl type Dt_RECORD_Apples: category=STRUCTURE, sw-calibration-access=READ-ONLY, type-emitter=RTE
    element sig1: implementation-data-type=boolean
    element sig2: implementation-data-type=uint8
    element sig3: implementation-data-type=Dt_sig3
  impl type Dt_sig3: category=ARRAY, sw-calibration-access=READ-ONLY, type-emitter=RTE
    element Element: array-size=8, array-size-semantics=FIXED-SIZE, implementation-data-type=uint8
package /PortInterfaces
  sender receiver interface PiVMS_Apples_123ms: invalidation-policy{data-element=DeApples, handle-invalid=DONT-INVALIDATE}
    data DeApples: type=Dt_RECORD_Apples
